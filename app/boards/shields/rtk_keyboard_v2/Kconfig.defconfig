## app/boards/shields/rtk_keyboard_v2/Kconfig.defconfig
```kconfig
# Copyright (c) 2024
# SPDX-License-Identifier: MIT

if SHIELD_RTK_KEYBOARD_v2

config ZMK_KEYBOARD_NAME
    default "RTK_KEYBOARD_V2"

endif
```

## app/boards/shields/rtk_keyboard_v2/Kconfig.shield
```kconfig
# Copyright (c) 2024
# SPDX-License-Identifier: MIT

config SHIELD_RTK_KEYBOARD_v2
    def_bool $(shields_list_contains,rtk_keyboard_v2)
```
